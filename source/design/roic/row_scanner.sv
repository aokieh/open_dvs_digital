//---------------------------------------------------------------------------
// Author: Ababakar Okieh
// Date  : April 3rd, 2026
//
// Module: row_scanner
//
// Description: 
//  A 64-row token-ring scanner and routing decoder for the OpenDVS array. 
//  It takes global phase-gated analog control pulses (ON/OFF detect) from 
//  the pacing FSM and routes them exclusively to the currently active row. 
//  The active row shifts circularly upon receiving the sm_next_row trigger.
//---------------------------------------------------------------------------

module row_scanner (
    `ifdef USE_POWER_PINS
        inout vccd1, // OpenLane Power  
        inout vssd1, // OpenLane Ground 
    `endif
    
    input  logic        div_clk,
    input  logic        rst_n,
    input  logic        sm_enable,      // [ADDED] To keep token in sync with FSM
    
    // Global Control Pulses (From roic_sm)
    input  logic        sm_on_detect,
    input  logic        sm_off_detect,
    // input  logic        sm_pixel_rst,
    
    // The Shift Trigger (Generated by roic_sm after pixel_rst)
    input  logic        sm_next_row,

    // Explicit 64-bit buses to the physical Imager Array
    output logic [63:0] row_on_detect,
    output logic [63:0] row_off_detect
    // output logic [63:0] row_pixel_rst,
    // output logic [63:0] row_sel  //TODO: remove this signal
);

    // -----------------------------------------------------------------
    // 1. THE SHIFT TOKEN (Registered)
    // -----------------------------------------------------------------
    logic [63:0] row_token;
    
    always_ff @(posedge div_clk or negedge rst_n) begin
        if (!rst_n) begin
            row_token <= 64'd1;        // Global reset send back to Row [0]
        end 
        else if (!sm_enable) begin     // Maintains current location if disabled
            row_token <= row_token;
        end
        else if (sm_next_row) begin
            row_token <= {row_token[62:0], row_token[63]}; 
        end
    end

    // -----------------------------------------------------------------
    // 2. COMBINATIONAL ARRAY DRIVERS (Fixed Latency Bug)
    // -----------------------------------------------------------------
    always_comb begin
        // Default everything to 0 to prevent latches
        row_on_detect  = '0;
        row_off_detect = '0;
        // row_pixel_rst  = '0;
        // row_sel        = '0;

        for (int i = 0; i < 64; i++) begin
            if (row_token[i]) begin
                // Directly route the FSM pulses to the active row with zero clock delay
                row_on_detect[i]  = sm_on_detect;
                row_off_detect[i] = sm_off_detect;
                // row_pixel_rst[i]  = sm_pixel_rst;
                // row_sel[i]        = 1'b1;
            end 
        end
    end

endmodule : row_scanner