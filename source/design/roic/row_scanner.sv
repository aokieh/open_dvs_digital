// module row_scanner (
//     `ifdef USE_POWER_PINS
//         inout vccd1, // OpenLane Power  
//         inout vssd1, // OpenLane Ground 
//     `endif
    
//     input  logic        div_clk,
//     input  logic        rst_n,
    
//     // Global Control Pulses (From roic_sm)
//     input  logic        sm_on_detect,
//     input  logic        sm_off_detect,
//     input  logic        sm_pixel_rst,
    
//     // The Shift Trigger (Generated by roic_sm after pixel_rst)
//     input  logic        sm_next_row,
//     // input  logic [5:0]  sm_row_addr,

//     // Explicit 64-bit buses to the physical Imager Array
//     output logic [63:0] row_on_detect,
//     output logic [63:0] row_off_detect,
//     output logic [63:0] row_pixel_rst,
//     output logic [63:0] row_sel
// );

//     // -----------------------------------------------------------------
//     // 1. THE SHIFT TOKEN
//     // A 64-bit register where only a single '1' exists at any time.
//     // Reset known state is for Row 0 to be selected
//     // -----------------------------------------------------------------
//     logic [63:0] row_token;
    
//     always_ff @(posedge div_clk or negedge rst_n) begin
//         if (!rst_n) begin
//             // Initialize the token at Row 0
//             row_token <= 64'd1; 
//         end 
//         else if (sm_next_row) begin
//             // Circular shift left. When it hits row 63, it wraps to row 0.
//             row_token <= {row_token[62:0], row_token[63]}; 
//         end
//     end

//     // -----------------------------------------------------------------
//     // 2. REGISTERED ARRAY DRIVERS
//     // We gate the FSM signals with the hot token and register them.
//     // -----------------------------------------------------------------
//     always_ff @(posedge div_clk or negedge rst_n) begin
//         if (!rst_n) begin
//             row_on_detect  <= '0;
//             row_off_detect <= '0;
//             row_pixel_rst  <= '0;
//             row_sel        <= '0;
//         end 
//         else begin
//             for (int i = 0; i < 64; i++) begin
//                 if (row_token[i]) begin
//                     // Route the FSM pulses ONLY to the row holding the token
//                     row_on_detect[i]  <= sm_on_detect;
//                     row_off_detect[i] <= sm_off_detect;
//                     row_pixel_rst[i]  <= sm_pixel_rst;
//                     row_sel[i]        <= 1'b1;
//                 end 
//                 else begin
//                     // Keep unselected rows completely quiet
//                     row_on_detect[i]  <= 1'b0;
//                     row_off_detect[i] <= 1'b0;
//                     row_pixel_rst[i]  <= 1'b0;
//                     row_sel[i]        <= 1'b0;
//                 end
//             end
//         end
//     end

// endmodule : row_scanner

module row_scanner (
    `ifdef USE_POWER_PINS
        inout vccd1, // OpenLane Power  
        inout vssd1, // OpenLane Ground 
    `endif
    
    input  logic        div_clk,
    input  logic        rst_n,
    input  logic        sm_enable,      // [ADDED] To keep token in sync with FSM
    
    // Global Control Pulses (From roic_sm)
    input  logic        sm_on_detect,
    input  logic        sm_off_detect,
    input  logic        sm_pixel_rst,
    
    // The Shift Trigger (Generated by roic_sm after pixel_rst)
    input  logic        sm_next_row,

    // Explicit 64-bit buses to the physical Imager Array
    output logic [63:0] row_on_detect,
    output logic [63:0] row_off_detect,
    output logic [63:0] row_pixel_rst,
    output logic [63:0] row_sel
);

    // -----------------------------------------------------------------
    // 1. THE SHIFT TOKEN (Registered)
    // -----------------------------------------------------------------
    logic [63:0] row_token;
    
    always_ff @(posedge div_clk or negedge rst_n) begin
        if (!rst_n) begin
            row_token <= 64'd1; 
        end 
        else if (!sm_enable) begin     // [ADDED] Instantly snap back to Row 0 if disabled
            row_token <= row_token;
        end
        else if (sm_next_row) begin
            row_token <= {row_token[62:0], row_token[63]}; 
        end
    end

    // -----------------------------------------------------------------
    // 2. COMBINATIONAL ARRAY DRIVERS (Fixed Latency Bug)
    // -----------------------------------------------------------------
    always_comb begin
        // Default everything to 0 to prevent latches
        row_on_detect  = '0;
        row_off_detect = '0;
        row_pixel_rst  = '0;
        row_sel        = '0;

        for (int i = 0; i < 64; i++) begin
            if (row_token[i]) begin
                // Directly route the FSM pulses to the active row with zero clock delay
                row_on_detect[i]  = sm_on_detect;
                row_off_detect[i] = sm_off_detect;
                row_pixel_rst[i]  = sm_pixel_rst;
                row_sel[i]        = 1'b1;
            end 
        end
    end

endmodule : row_scanner